/**
 * @cliArgs --board "/boards/LAUNCHXL_F28379D" --context "CPU1" --product "C2000WARE@5.01.00.00"
 * @versions {"tool":"1.19.0+3426"}
 */

/**
 * Import the modules used in this configuration.
 */
const led   = scripting.addModule("/driverlib/board_components/led", {}, false);
const led1  = led.addInstance();
const led2  = led.addInstance();
const gpio  = scripting.addModule("/driverlib/gpio.js", {}, false);
const gpio1 = gpio.addInstance();
const gpio2 = gpio.addInstance();

/**
 * Write custom configuration values to the imported modules.
 */
led1.$name                  = "myBoardLED0";
led1.$hardware              = system.deviceData.board.components.LED4;
led1.gpio.writeInitialValue = true;

led2.$name                  = "myBoardLED1";
led2.$hardware              = system.deviceData.board.components.LED5;
led2.gpio.writeInitialValue = true;
led2.gpio.initialValue      = 1;

gpio1.direction       = "GPIO_DIR_MODE_OUT";
gpio1.$name           = "EN1_M1";
gpio1.gpioPin.$assign = "boosterpack2.79";
scripting.suppress("Connected to hardware,@@@.+?@@@ is connected to EPWM4 BP on the LaunchPad F28379D\\. Consider selecting it in 'use hardware' above\\. @@@.+?@@@", gpio1, "gpioPin");

gpio2.direction       = "GPIO_DIR_MODE_OUT";
gpio2.initialValue    = 1;
gpio2.$name           = "EN2_M1";
gpio2.gpioPin.$assign = "boosterpack2.80";
scripting.suppress("Connected to hardware,@@@.+?@@@ is connected to EPWM4 BP on the LaunchPad F28379D\\. Consider selecting it in 'use hardware' above\\. @@@.+?@@@", gpio2, "gpioPin");

/**
 * Pinmux solution for unlocked pins/peripherals. This ensures that minor changes to the automatic solver in a future
 * version of the tool will not impact the pinmux you originally saw.  These lines can be completely deleted in order to
 * re-solve from scratch.
 */
led1.gpio.gpioPin.$suggestSolution = "GPIO31";
led2.gpio.gpioPin.$suggestSolution = "GPIO34";
